/dts-v1/;
/plugin/;

/*
 * WiseEff DTS reload debugging — generated debug overlay.
 * Authored by the platform from resolved parameter bindings; never hand-edited.
 * Debug values are run-scoped and do not change the parameter library.
 */

/ {
	fragment@0 {
		target-path = "/amba/i2c@FDF5E000/sc8562@6E";

		__overlay__ {
			compatible = "sc8562", "sc8562-v2";
		};
	};
};
